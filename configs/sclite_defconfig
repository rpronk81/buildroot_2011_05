## configs/sclite_defconfig
```kconfig
BR2_arm=y
BR2_arm926t=y
BR2_BACKUP_SITE="http://sources.buildroot.net"
BR2_KERNEL_MIRROR="https://www.kernel.org/pub"
BR2_JLEVEL=8
BR2_CCACHE=y
BR2_TOOLCHAIN_EXTERNAL=y
BR2_TOOLCHAIN_EXTERNAL_CODESOURCERY_ARM201009=y
BR2_TARGET_OPTIMIZATION=""
BR2_ROOTFS_DEVICE_TABLE="system/device_table.txt"
BR2_TARGET_GENERIC_GETTY_PORT="ttyNS1"
BR2_ROOTFS_POST_BUILD_SCRIPT="./package/editrfs.sh"
BR2_PACKAGE_BUSYBOX_CONFIG="package/busybox/busybox.config"
BR2_PACKAGE_BUSYBOX_SHOW_OTHERS=y
BR2_PACKAGE_CAN_UTILS=y
BR2_PACKAGE_IW=y
BR2_PACKAGE_LIGHTTPD=y
BR2_PACKAGE_LIGHTTPD_OPENSSL=y
BR2_PACKAGE_NTP=y
BR2_PACKAGE_NTP_NTPDATE=y
BR2_PACKAGE_PROFTPD=y
BR2_PACKAGE_WPA_SUPPLICANT=y
BR2_PACKAGE_WPA_SUPPLICANT_EAP=y
BR2_PACKAGE_WPA_SUPPLICANT_CLI=y
BR2_PACKAGE_WPA_SUPPLICANT_PASSPHRASE=y
BR2_TARGET_ROOTFS_JFFS2=y
# BR2_TARGET_ROOTFS_TAR is not set
BR2_TARGET_ROOTFS_INITRAMFS=y
BR2_TARGET_UBOOT=y
BR2_TARGET_UBOOT_BOARDNAME="cc9p9215"
BR2_TARGET_UBOOT_2010_09=y
# BR2_TARGET_UBOOT_NETWORK is not set
BR2_LINUX_KERNEL=y
BR2_LINUX_KERNEL_CUSTOM_VERSION=y
BR2_LINUX_KERNEL_CUSTOM_VERSION_VALUE="2.6.34"
BR2_LINUX_KERNEL_PATCH="package/34to3412.patch package/ns921-1.patch package/ns921-2.patch package/ns921-3.patch"
BR2_LINUX_KERNEL_USE_CUSTOM_CONFIG=y
BR2_LINUX_KERNEL_CUSTOM_CONFIG_FILE="output/build/linux-2.6.34/arch/arm/configs/spacecom_lite_defconfig"
```

## configs/spacecom2_defconfig
```kconfig
BR2_powerpc=y
BR2_powerpc_601=y
BR2_HOST_DIR="/opt/buildroot-2011.05-ppc"
BR2_BACKUP_SITE="http://sources.buildroot.net"
BR2_KERNEL_MIRROR="https://www.kernel.org/pub"
BR2_JLEVEL=8
BR2_TOOLCHAIN_EXTERNAL=y
BR2_SOFT_FLOAT=y
BR2_TARGET_OPTIMIZATION=""
BR2_TARGET_GENERIC_HOSTNAME="spacecomlite"
BR2_ROOTFS_DEVICE_CREATION_DYNAMIC_UDEV=y
BR2_ROOTFS_DEVICE_TABLE="system/device_table.txt"
BR2_TARGET_GENERIC_GETTY_PORT="ttyPSC0"
BR2_ROOTFS_POST_BUILD_SCRIPT="./package/editrfs.sh"
BR2_PACKAGE_BUSYBOX_CONFIG="package/busybox/busybox.config"
BR2_PACKAGE_BUSYBOX_SHOW_OTHERS=y
BR2_PACKAGE_CUSTOMIZE=y
BR2_DBUS_LIBXML2=y
BR2_PACKAGE_DOSFSTOOLS=y
BR2_PACKAGE_DOSFSTOOLS_MKDOSFS=y
BR2_PACKAGE_DOSFSTOOLS_DOSFSCK=y
BR2_PACKAGE_IOSTAT=y
BR2_PACKAGE_MTD=y
# BR2_PACKAGE_MTD_FLASH_ERASEALL is not set
# BR2_PACKAGE_MTD_FLASH_INFO is not set
# BR2_PACKAGE_MTD_FLASH_LOCK is not set
# BR2_PACKAGE_MTD_FLASH_UNLOCK is not set
# BR2_PACKAGE_MTD_MTD_DEBUG is not set
# BR2_PACKAGE_MTD_NANDDUMP is not set
# BR2_PACKAGE_MTD_NANDTEST is not set
# BR2_PACKAGE_MTD_NANDWRITE is not set
# BR2_PACKAGE_MTD_MTDINFO is not set
# BR2_PACKAGE_MTD_UBIATTACH is not set
# BR2_PACKAGE_MTD_UBICRC32 is not set
# BR2_PACKAGE_MTD_UBIDETACH is not set
# BR2_PACKAGE_MTD_UBIFORMAT is not set
# BR2_PACKAGE_MTD_UBIMKVOL is not set
# BR2_PACKAGE_MTD_UBINFO is not set
# BR2_PACKAGE_MTD_UBINIZE is not set
# BR2_PACKAGE_MTD_UBIRENAME is not set
# BR2_PACKAGE_MTD_UBIRMVOL is not set
# BR2_PACKAGE_MTD_UBIRSVOL is not set
# BR2_PACKAGE_MTD_UBIUPDATEVOL is not set
BR2_PACKAGE_UDEV_RULES_GEN=y
BR2_PACKAGE_PHP=y
BR2_PACKAGE_PHP_SAPI_CLI_CGI=y
BR2_PACKAGE_PHP_CONFIG="$(PHP_DIR)/../../../package/php/php.ini"
BR2_PACKAGE_PHP_EXT_SOCKETS=y
BR2_PACKAGE_PHP_EXT_OPENSSL=y
BR2_PACKAGE_PHP_EXT_SIMPLEXML=y
BR2_PACKAGE_PHP_EXT_EXIF=y
BR2_PACKAGE_PHP_EXT_FTP=y
BR2_PACKAGE_PHP_EXT_GETTEXT=y
BR2_PACKAGE_PHP_EXT_GMP=y
BR2_PACKAGE_PHP_EXT_JSON=y
BR2_PACKAGE_PHP_EXT_PCNTL=y
BR2_PACKAGE_PHP_EXT_ZIP=y
BR2_PACKAGE_PHP_EXT_FILTER=y
BR2_PACKAGE_PHP_EXT_CALENDAR=y
BR2_PACKAGE_OPENSSL_BIN=y
BR2_PACKAGE_LIBSYSFS=y
BR2_PACKAGE_LIBCURL=y
BR2_PACKAGE_CURL=y
BR2_PACKAGE_LIBCAP=y
BR2_PACKAGE_LIBFFI=y
BR2_PACKAGE_JSON_C=y
BR2_PACKAGE_BRIDGE=y
BR2_PACKAGE_CAN_UTILS=y
BR2_PACKAGE_JSON_DBUS_BRIDGE=y
BR2_PACKAGE_LIGHTTPD=y
BR2_PACKAGE_LIGHTTPD_OPENSSL=y
BR2_PACKAGE_LIGHTTPD_ZLIB=y
BR2_PACKAGE_LIGHTTPD_BZIP2=y
BR2_PACKAGE_LIGHTTPD_PCRE=y
BR2_PACKAGE_NETKITTELNET=y
BR2_PACKAGE_NETWORKMANAGER=y
BR2_PACKAGE_NTP=y
BR2_PACKAGE_NTP_NTPDATE=y
BR2_PACKAGE_OPENSSH=y
BR2_PACKAGE_PROFTPD=y
BR2_PACKAGE_SPAWN_FCGI=y
BR2_PACKAGE_WPA_SUPPLICANT=y
BR2_PACKAGE_WPA_SUPPLICANT_EAP=y
BR2_PACKAGE_WPA_SUPPLICANT_CLI=y
BR2_PACKAGE_WPA_SUPPLICANT_DBUS_OLD=y
BR2_PACKAGE_DASH=y
BR2_PACKAGE_POLKIT=y
BR2_PACKAGE_LIBNSS=y
BR2_PACKAGE_MODULE_INIT_TOOLS=y
BR2_PACKAGE_METALOG=y
BR2_PACKAGE_UTILLINUX=y
BR2_TARGET_ROOTFS_JFFS2=y
BR2_TARGET_ROOTFS_JFFS2_LE=y
# BR2_TARGET_ROOTFS_TAR is not set
BR2_LINUX_KERNEL=y
BR2_LINUX_KERNEL_CUSTOM_VERSION=y
BR2_LINUX_KERNEL_CUSTOM_VERSION_VALUE="2.6.34"
BR2_LINUX_KERNEL_PATCH="package/34to3412.patch package/linux-wifi.patch package/linux-wifi-makefile.patch package/linux-rtl8712.patch package/linux-spacecom2.patch"
BR2_LINUX_KERNEL_USE_CUSTOM_CONFIG=y
BR2_LINUX_KERNEL_CUSTOM_CONFIG_FILE="package/linux_config"
```

## configs/spacecom_lite_minimal_defconfig
```kconfig
BR2_arm=y
BR2_arm926t=y
BR2_BACKUP_SITE="http://sources.buildroot.net"
BR2_KERNEL_MIRROR="https://www.kernel.org/pub"
BR2_JLEVEL=8
BR2_TOOLCHAIN_EXTERNAL=y
BR2_TOOLCHAIN_EXTERNAL_CODESOURCERY_ARM201009=y
BR2_ENABLE_LOCALE_PURGE=y
BR2_TARGET_OPTIMIZATION=""
BR2_TARGET_GENERIC_HOSTNAME="spacecomlite"
BR2_ROOTFS_DEVICE_CREATION_DYNAMIC_UDEV=y
BR2_ROOTFS_DEVICE_TABLE="system/device_table.txt"
BR2_TARGET_GENERIC_GETTY_PORT="ttyNS1"
BR2_ROOTFS_POST_BUILD_SCRIPT="./package/editrfs.sh"
BR2_PACKAGE_BUSYBOX_CONFIG="package/busybox/busybox.config"
BR2_PACKAGE_BUSYBOX_SHOW_OTHERS=y
BR2_PACKAGE_CUSTOMIZE=y
BR2_DBUS_LIBXML2=y
BR2_PACKAGE_DOSFSTOOLS=y
BR2_PACKAGE_DOSFSTOOLS_MKDOSFS=y
BR2_PACKAGE_DOSFSTOOLS_DOSFSCK=y
BR2_PACKAGE_IOSTAT=y
BR2_PACKAGE_MTD=y
# BR2_PACKAGE_MTD_FLASH_ERASEALL is not set
# BR2_PACKAGE_MTD_FLASH_INFO is not set
# BR2_PACKAGE_MTD_FLASH_LOCK is not set
# BR2_PACKAGE_MTD_FLASH_UNLOCK is not set
# BR2_PACKAGE_MTD_MTD_DEBUG is not set
# BR2_PACKAGE_MTD_NANDDUMP is not set
# BR2_PACKAGE_MTD_NANDTEST is not set
# BR2_PACKAGE_MTD_NANDWRITE is not set
# BR2_PACKAGE_MTD_MTDINFO is not set
# BR2_PACKAGE_MTD_UBIATTACH is not set
# BR2_PACKAGE_MTD_UBICRC32 is not set
# BR2_PACKAGE_MTD_UBIDETACH is not set
# BR2_PACKAGE_MTD_UBIFORMAT is not set
# BR2_PACKAGE_MTD_UBIMKVOL is not set
# BR2_PACKAGE_MTD_UBINFO is not set
# BR2_PACKAGE_MTD_UBINIZE is not set
# BR2_PACKAGE_MTD_UBIRENAME is not set
# BR2_PACKAGE_MTD_UBIRMVOL is not set
# BR2_PACKAGE_MTD_UBIRSVOL is not set
# BR2_PACKAGE_MTD_UBIUPDATEVOL is not set
BR2_PACKAGE_UDEV_RULES_GEN=y
BR2_PACKAGE_OPENSSL_BIN=y
BR2_PACKAGE_LIBCAP=y
BR2_PACKAGE_PCRE=y
BR2_PACKAGE_LIBXML2=y
BR2_PACKAGE_BRIDGE=y
BR2_PACKAGE_CAN_UTILS=y
BR2_PACKAGE_LIGHTTPD=y
BR2_PACKAGE_NETKITTELNET=y
BR2_PACKAGE_NETWORKMANAGER=y
BR2_PACKAGE_NTP=y
# BR2_PACKAGE_NTP_NTPD is not set
BR2_PACKAGE_NTP_NTPDATE=y
BR2_PACKAGE_OPENSSH=y
BR2_PACKAGE_PROFTPD=y
BR2_PACKAGE_WPA_SUPPLICANT=y
BR2_PACKAGE_WPA_SUPPLICANT_EAP=y
BR2_PACKAGE_WPA_SUPPLICANT_CLI=y
BR2_PACKAGE_WPA_SUPPLICANT_DBUS_OLD=y
BR2_PACKAGE_DASH=y
BR2_PACKAGE_POLKIT=y
BR2_PACKAGE_LIBNSS=y
BR2_PACKAGE_MODULE_INIT_TOOLS=y
BR2_PACKAGE_UTILLINUX=y
BR2_TARGET_ROOTFS_JFFS2=y
# BR2_TARGET_ROOTFS_TAR is not set
BR2_TARGET_UBOOT=y
BR2_TARGET_UBOOT_BOARDNAME="cc9p9215"
BR2_TARGET_UBOOT_2010_09=y
# BR2_TARGET_UBOOT_NETWORK is not set
BR2_LINUX_KERNEL=y
BR2_LINUX_KERNEL_CUSTOM_VERSION=y
BR2_LINUX_KERNEL_CUSTOM_VERSION_VALUE="2.6.34"
BR2_LINUX_KERNEL_PATCH="package/34to3412.patch package/ns921-1.patch package/ns921-2.patch package/ns921-3.patch /home/robert/svn/trunk/buildroot/ns921-non_gpl.patch package/linux_config.patch package/linux_rtc.patch"
BR2_LINUX_KERNEL_USE_CUSTOM_CONFIG=y
BR2_LINUX_KERNEL_CUSTOM_CONFIG_FILE="output/build/linux-2.6.34/arch/arm/configs/spacecom_lite_defconfig"
```

## configs/spacecomlite_defconfig
```kconfig
BR2_arm=y
BR2_arm926t=y
BR2_HOST_DIR="/opt/buildroot-2011.05"
BR2_BACKUP_SITE="http://sources.buildroot.net"
BR2_SOURCEFORGE_MIRROR="kent"
BR2_KERNEL_MIRROR="https://www.kernel.org/pub"
BR2_GNU_MIRROR="http://ftp.gnu.org/pub/gnu"
BR2_DEBIAN_MIRROR="http://ftp.debian.org"
BR2_JLEVEL=8
BR2_TOOLCHAIN_EXTERNAL=y
BR2_TOOLCHAIN_EXTERNAL_CODESOURCERY_ARM201009=y
BR2_TARGET_OPTIMIZATION=""
BR2_TARGET_GENERIC_HOSTNAME="spacecomlite"
BR2_ROOTFS_DEVICE_CREATION_DYNAMIC_UDEV=y
BR2_ROOTFS_DEVICE_TABLE="system/device_table.txt"
BR2_ROOTFS_SKELETON_DEFAULT=y
BR2_TARGET_GENERIC_GETTY_PORT="ttyNS1"
BR2_TARGET_GENERIC_GETTY_BAUDRATE_115200=y
BR2_TARGET_GENERIC_GETTY_BAUDRATE="115200"
BR2_ROOTFS_POST_BUILD_SCRIPT="./package/editrfs.sh"
BR2_PACKAGE_BUSYBOX=y
BR2_BUSYBOX_VERSION_1_18_X=y
BR2_BUSYBOX_VERSION="1.18.4"
BR2_PACKAGE_BUSYBOX_CONFIG="package/busybox/busybox.config"
BR2_PACKAGE_BUSYBOX_SHOW_OTHERS=y
BR2_PACKAGE_BZIP2=y
BR2_PACKAGE_GMP=y
BR2_PACKAGE_DBUS=y
BR2_DBUS_LIBXML2=y
BR2_PACKAGE_DBUS_GLIB=y
BR2_PACKAGE_DOSFSTOOLS=y
BR2_PACKAGE_DOSFSTOOLS_MKDOSFS=y
BR2_PACKAGE_DOSFSTOOLS_DOSFSCK=y
BR2_PACKAGE_HWDATA=y
BR2_PACKAGE_IOSTAT=y
BR2_PACKAGE_MTD=y
BR2_PACKAGE_MTD_FLASHCP=y
BR2_PACKAGE_MTD_FLASH_ERASE=y

BR2_PACKAGE_UDEV=y
BR2_PACKAGE_UDEV_RULES_GEN=y
BR2_PACKAGE_UDEV_ALL_EXTRAS=y
BR2_PACKAGE_PHP=y
BR2_PACKAGE_PHP_CLI=y
BR2_PACKAGE_PHP_CGI=y
BR2_PACKAGE_PHP_SAPI_CLI_CGI=y
BR2_PACKAGE_PHP_FASTCGI=y
BR2_PACKAGE_PHP_CONFIG="$(PHP_DIR)/../../../package/php/php.ini"
BR2_PACKAGE_PHP_EXT_SOCKETS=y
BR2_PACKAGE_PHP_EXT_POSIX=y
BR2_PACKAGE_PHP_EXT_SPL=y
BR2_PACKAGE_PHP_EXT_SESSION=y
BR2_PACKAGE_PHP_EXT_OPENSSL=y
BR2_PACKAGE_PHP_EXT_LIBXML2=y
BR2_PACKAGE_PHP_EXT_SIMPLEXML=y
BR2_PACKAGE_PHP_EXT_ZLIB=y
BR2_PACKAGE_PHP_EXT_EXIF=y
BR2_PACKAGE_PHP_EXT_FTP=y
BR2_PACKAGE_PHP_EXT_GETTEXT=y
BR2_PACKAGE_PHP_EXT_GMP=y
BR2_PACKAGE_PHP_EXT_JSON=y
BR2_PACKAGE_PHP_EXT_PCRE=y
BR2_PACKAGE_PHP_EXT_PCNTL=y
BR2_PACKAGE_PHP_EXT_ZIP=y
BR2_PACKAGE_PHP_EXT_FILTER=y
BR2_PACKAGE_PHP_EXT_CALENDAR=y

BR2_PACKAGE_ZLIB=y

BR2_PACKAGE_GNUTLS=y
BR2_PACKAGE_LIBGCRYPT=y
BR2_PACKAGE_LIBGPG_ERROR=y
BR2_PACKAGE_OPENSSL=y
BR2_PACKAGE_OPENSSL_BIN=y

BR2_PACKAGE_SQLITE=y

BR2_PACKAGE_LIBSYSFS=y

BR2_PACKAGE_LIBCURL=y
BR2_PACKAGE_CURL=y

BR2_PACKAGE_LIBFCGI=y
BR2_PACKAGE_LIBNL=y

BR2_PACKAGE_LIBCAP=y

BR2_PACKAGE_LIBEVENT=y
BR2_PACKAGE_LIBFFI=y
BR2_PACKAGE_LIBGLIB2=y
BR2_PACKAGE_LIBNSPR=y

BR2_PACKAGE_PCRE=y

BR2_PACKAGE_EXPAT=y

BR2_PACKAGE_JSON_C=y
BR2_PACKAGE_LIBXML2=y
BR2_PACKAGE_YAML_CPP=y

BR2_PACKAGE_BOOST=y
BR2_PACKAGE_BOOST_LAYOUT_SYSTEM=y
BR2_PACKAGE_BOOST_LAYOUT="system"
BR2_PACKAGE_BOOST_ATOMIC=y
BR2_PACKAGE_BOOST_CHRONO=y
BR2_PACKAGE_BOOST_DATE_TIME=y
BR2_PACKAGE_BOOST_FILESYSTEM=y
BR2_PACKAGE_BOOST_SERIALIZATION=y
BR2_PACKAGE_BOOST_THREAD=y

BR2_PACKAGE_BRIDGE=y
BR2_PACKAGE_CAN_UTILS=y
BR2_PACKAGE_DHCP=y
BR2_PACKAGE_DHCP_CLIENT=y
BR2_PACKAGE_IPROUTE2=y
BR2_PACKAGE_JSON_DBUS_BRIDGE=y

BR2_PACKAGE_LIGHTTPD=y
BR2_PACKAGE_LIGHTTPD_OPENSSL=y
BR2_PACKAGE_LIGHTTPD_ZLIB=y
BR2_PACKAGE_LIGHTTPD_BZIP2=y
BR2_PACKAGE_LIGHTTPD_PCRE=y

BR2_PACKAGE_NETKITBASE=y
BR2_PACKAGE_NETKITTELNET=y

BR2_PACKAGE_NETWORKMANAGER=y

BR2_PACKAGE_NTP=y

BR2_PACKAGE_NTP_NTPD=y
BR2_PACKAGE_NTP_NTPDATE=y

BR2_PACKAGE_OPENSSH=y

BR2_PACKAGE_SPAWN_FCGI=y

BR2_PACKAGE_WIRELESS_TOOLS=y
BR2_PACKAGE_WIRELESS_TOOLS_LIB=y
BR2_PACKAGE_WPA_SUPPLICANT=y

BR2_PACKAGE_WPA_SUPPLICANT_EAP=y

BR2_PACKAGE_WPA_SUPPLICANT_CLI=y

BR2_PACKAGE_WPA_SUPPLICANT_DBUS_OLD=y

BR2_PACKAGE_DASH=y

BR2_PACKAGE_POLKIT=y
BR2_PACKAGE_LIBNSS=y

BR2_PACKAGE_KMOD=y

BR2_PACKAGE_MODULE_INIT_TOOLS=y
BR2_PACKAGE_METALOG=y

BR2_PACKAGE_UTILLINUX=y
BR2_PACKAGE_UTILLINUX_LIBUUID=y

BR2_PACKAGE_UTILLINUX_LIBBLKID=y

BR2_TARGET_ROOTFS_TAR=y

BR2_TARGET_ROOTFS_TAR_GZIP=y


BR2_TARGET_ROOTFS_TAR_OPTIONS=""

BR2_TARGET_UBOOT=y
BR2_TARGET_UBOOT_BOARDNAME="cc9p9215"
BR2_TARGET_UBOOT_2010_09=y
BR2_TARGET_UBOOT_VERSION="2010.09"
BR2_TARGET_UBOOT_CUSTOM_PATCH_DIR=""
BR2_TARGET_UBOOT_FORMAT_BIN=y

BR2_LINUX_KERNEL=y
BR2_LINUX_KERNEL_CUSTOM_VERSION=y
BR2_LINUX_KERNEL_CUSTOM_VERSION_VALUE="2.6.34"
BR2_LINUX_KERNEL_VERSION="2.6.34"
BR2_LINUX_KERNEL_PATCH="package/34to3412.patch package/ns921-1.patch package/ns921-2.patch package/ns921-3.patch /home/dev/pump-model-interface-buildroot/buildroot/ns921-non_gpl.patch package/linux_config.patch package/linux_config2.patch"
BR2_LINUX_KERNEL_USE_CUSTOM_CONFIG=y
BR2_LINUX_KERNEL_CUSTOM_CONFIG_FILE="output/build/linux-2.6.34/arch/arm/configs/spacecomlite_defconfig"
BR2_LINUX_KERNEL_UIMAGE=y
```

## package/boost/Config.in
```kconfig
config BR2_PACKAGE_BOOST
	bool "boost"
	select BR2_PACKAGE_ZLIB
	help
	Boost provides free peer-reviewed portable C++ source libraries.  
        We emphasize libraries that work well with the C++ Standard Library. 
        Boost libraries are intended to be widely useful, and usable across 
        a broad spectrum of applications. The Boost license encourages 
        both commercial and non-commercial use.

	  http://www.boost.org
```

## package/dbus-glib/Config.in
```kconfig
config BR2_PACKAGE_DBUS_GLIB
	bool "dbus-glib"
	select BR2_PACKAGE_GETTEXT
	# select BR2_PACKAGE_GETTEXT if BR2_NEEDS_GETTEXT_IF_LOCALE
	depends on BR2_PACKAGE_DBUS
	depends on BR2_USE_WCHAR # glib2
	#
	# GETTEXT is a run time dependency only.
	#
	select BR2_PACKAGE_LIBGLIB2
	help
	  GLib bindings for D-Bus.

	  http://www.freedesktop.org/software/dbus

comment "dbus-glib requires a toolchain with WCHAR support"
	depends on BR2_PACKAGE_DBUS && !BR2_USE_WCHAR
```

## package/json-dbus-bridge/Config.in
```kconfig
config BR2_PACKAGE_JSON_DBUS_BRIDGE
	bool "json-dbus-bridge"
	depends on BR2_PACKAGE_JSON_C
	select     BR2_PACKAGE_LIBFCGI
	select     BR2_PACKAGE_LIBEVENT
	help
	json-dbus-bridge is a fast-cgi application that provides access to D-Bus.
	It accepts JSON-RPC[1] calls as used by qooxdoo[2] and translates these
	into D-Bus calls. Any response is converted back to JSON and sent to the
	client.
	The bridge is completely generic. New D-Bus services can be added without
	modifications to the bridge.

comment "JSON Dbus Bridge requires JSON-C libfcgi and libevent 2.X" 
```

## package/libegg/Config.in
```kconfig
config BR2_PACKAGE_LIBEGG
	bool "libegg"
	help
	  Userspace library for egg rolls.

	  http:examplenow.com/la/package/libeggdbus_1-0
```

## package/libudev/Config.in
```kconfig
config BR2_PACKAGE_LIBUDEV
	bool "libudev"
	select BR2_PACKAGE_INTLTOOL 
	select BR2_PACKAGE_LIBGCRYPT
	help
	  https://wiki.gnome.org/Projects/libudev
```

## package/metalog/Config.in
```kconfig
config BR2_PACKAGE_METALOG
	bool "metalog"
	help
	  metalog Hooray for logs, and for Beer.
```

## package/networkmanager/Config.in
```kconfig
config BR2_PACKAGE_NETWORKMANAGER
	bool "networkmanager"
	select BR2_PACKAGE_DBUS
	select BR2_PACKAGE_LIBNL
	select BR2_PACKAGE_LIBNSS
	select BR2_PACKAGE_WIRELESS_TOOLS
	select BR2_PACKAGE_POLKIT
	help
	  The point of NetworkManager is to make networking configuration and
	  setup as painless and automatic as possible. If using DHCP,
	  NetworkManager is intended to replace default routes, obtain IP
	  addresses from a DHCP server and change nameservers whenever it 
	  sees fit. In effect, the goal of NetworkManager is to make 
	  networking Just Work.
	  https://wiki.debian.org/NetworkManager
```
